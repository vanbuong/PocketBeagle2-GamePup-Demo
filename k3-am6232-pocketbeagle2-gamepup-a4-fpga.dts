// SPDX-License-Identifier: GPL-2.0-only
/dts-v1/;
/plugin/;

/*
 * Tang Nano 9K FPGA display (480x272, SPI slave) instead of the cape's ILI9341.
 *
 * Load this overlay AFTER k3-am6232-pocketbeagle2-gamepup-a4.dtbo.  It disables
 * the cape LCD node and adds a generic MIPI-DBI panel on the same SPI2 bus and
 * the same D/C (P2.17) and reset (P2.19) pins.  The FPGA emulates the MIPI-DBI
 * type C command set; see fpga/tang-nano-9k/ and docs/FPGA_TANG_NANO_9K_PLAN.md.
 *
 * Select with:  sudo gamepup-display fpga   (or  lcd  to go back)
 *
 * Driver: panel-mipi-dbi (compatible "panel-mipi-dbi-spi").  The init command
 * sequence is read from /lib/firmware/gamepup,fpga-lcd480x272.bin, built from
 * fpga/linux/gamepup,fpga-lcd480x272.txt.
 */

/include/ "gamepup-fpga-display.dtsi"
